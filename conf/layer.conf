## conf/layer.conf
```bitbake
# We have a conf and classes directory, add to BBPATH
BBPATH .= ":${LAYERDIR}"

# We have recipes-* directories, add to BBFILES
BBFILES += "${LAYERDIR}/recipes-*/*/*.bb \
	${LAYERDIR}/recipes-*/*/*.bbappend"

BBFILE_COLLECTIONS += "drif-ebisu-4d"
BBFILE_PATTERN_drif-ebisu-4d = "^${LAYERDIR}/"
BBFILE_PRIORITY_drif-ebisu-4d = "6"
```
